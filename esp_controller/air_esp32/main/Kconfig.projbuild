## esp_controller/air_esp32/main/Kconfig.projbuild
```kconfig
menu "Drone Air bridge"
    menu "STM32 UART link"
        config DRONE_UART_PORT
            int "UART controller number"
            range 0 2
            default 1
        config DRONE_UART_TX_GPIO
            int "ESP TX GPIO (connect to STM32 USART1 RX/PA10)"
            range 0 39
            default 17
        config DRONE_UART_RX_GPIO
            int "ESP RX GPIO (connect to STM32 USART1 TX/PA9)"
            range 0 39
            default 18
        config DRONE_UART_BAUD_RATE
            int "UART baud rate"
            range 115200 921600
            default 460800
    endmenu

    config DRONE_STATUS_LED_GPIO
        int "WS2812 data GPIO"
        range 0 39
        default 2
endmenu
```

## esp_controller/air_esp32/sdkconfig.defaults
```kconfig
CONFIG_COMPILER_OPTIMIZATION_SIZE=y
CONFIG_ESP_WIFI_SOFTAP_SUPPORT=n
CONFIG_ESP_CONSOLE_SECONDARY_NONE=y
```

## esp_controller/ground_s3/main/Kconfig.projbuild
```kconfig
menu "Drone Ground bridge"
    config DRONE_STATUS_LED_GPIO
        int "WS2812 data GPIO"
        range 0 48
        default 48
endmenu
```

## esp_controller/main/Kconfig.projbuild
```kconfig
menu "Drone controller"
    menu "STM32 UART link (air bridge only)"
        config DRONE_UART_PORT
            int "UART controller number"
            range 0 2
            default 1
        config DRONE_UART_TX_GPIO
            int "ESP TX GPIO (connect to STM32 USART1 RX/PA10)"
            range 0 39 if IDF_TARGET_ESP32
            range 0 48 if IDF_TARGET_ESP32S3
            default 17
        config DRONE_UART_RX_GPIO
            int "ESP RX GPIO (connect to STM32 USART1 TX/PA9)"
            range 0 39 if IDF_TARGET_ESP32
            range 0 48 if IDF_TARGET_ESP32S3
            default 18
        config DRONE_UART_BAUD_RATE
            int "UART baud rate"
            range 115200 921600
            default 460800
    endmenu

    menu "WS2812 status LED"
        config DRONE_STATUS_LED_GPIO
            int "WS2812 data GPIO"
            range 0 39 if IDF_TARGET_ESP32
            range 0 48 if IDF_TARGET_ESP32S3
            default 48 if IDF_TARGET_ESP32S3
            default 2 if IDF_TARGET_ESP32
    endmenu
endmenu
```

## esp_controller/rfid_s3/sdkconfig.defaults
```kconfig
CONFIG_ESPTOOLPY_FLASHSIZE_16MB=y
CONFIG_COMPILER_OPTIMIZATION_SIZE=y
CONFIG_ESP_CONSOLE_NONE=y
# CONFIG_ESP_CONSOLE_USB_SERIAL_JTAG is not set
CONFIG_ESP_SYSTEM_PANIC_PRINT_REBOOT=y
```

## stm32cube/esp_controller/sdkconfig.defaults
```kconfig
CONFIG_ESP_WIFI_SOFTAP_SUPPORT=y
CONFIG_HTTPD_MAX_REQ_HDR_LEN=1024
CONFIG_HTTPD_WS_SUPPORT=y
CONFIG_COMPILER_OPTIMIZATION_SIZE=y
```
